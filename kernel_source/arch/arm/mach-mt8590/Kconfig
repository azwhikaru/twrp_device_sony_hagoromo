## kernel_source/drivers/mmc/Kconfig
```kconfig
#
# MMC subsystem configuration
#

menuconfig MMC
	tristate "MMC/SD/SDIO card support"
	depends on HAS_IOMEM
	help
	  This selects MultiMediaCard, Secure Digital and Secure
	  Digital I/O support.

	  If you want MMC/SD/SDIO support, you should say Y here and
	  also to your specific host controller driver.

config MMC_MULTIPLE_CARDS
       bool "multiple MMC cards support"
       depends on MMC
       default n
       help
	 If you want multiple MMC cards support, you should say
	 Y here.

config MMC_MULTIPLE_CARDS_CMD_SWITCH
       bool "multiple MMC cards by switching CMD line"
       depends on MMC_MULTIPLE_CARDS
       default n
       help
	 If you want multiple MMC cards by switching CMD line, you should say
	 Y here.

config MMC_HS200
       bool "MMC HS200 Mode"
       depends on MMC
       default n
       help
	 If you want support HS200 Mode, you should say
	 Y here.

config MMC_DEBUG
	bool "MMC debugging"
	depends on MMC != n
	help
	  This is an option for use by developers; most people should
	  say N here.  This enables MMC core and driver debugging.

if MMC

source "drivers/mmc/core/Kconfig"

source "drivers/mmc/card/Kconfig"

source "drivers/mmc/host/Kconfig"

endif # MMC
```

## kernel_source/sound/soc/mediatek/Kconfig
```kconfig
menuconfig SND_SOC_MT8135
    bool "SoC Audio support for MT8135"
    depends on ARCH_MT8135
    help
        If you say Y, enable SND_SOC_MT8135.

config SND_SOC_MT6595
    bool "SND_SOC_MT6595"
    depends on ARCH_MT6595
    default y
    help
        If you say Y, enable SND_SOC_MT6595 driver.

config MTK_SPEAKER
    bool "MTK_SPEAKER"
    depends on ARCH_MT6595
    default y
    help
        If you say Y, enable MTK_SPEAKER_AMP
        
config SND_SOC_MT8127
    tristate "SoC Audio for MediaTek MT8127"
    depends on ARCH_MT8127
    default n
    help
        Say Y if you want to add support for SoC audio on the MediaTek MT8127 platform.

config SND_SOC_MT8590
    bool "SoC Audio support for MT8590"
    depends on ARCH_MT8590
    help
        If you say Y, enable SND_SOC_MT8590.

config SND_SOC_ICX_BOARD
	bool "SoC audio support for ICX audio daughter board"
	help
          Say Y if you want to add support for SoC audio on ICX Audio Daughter Board.

config SND_SOC_ICX_AUDIO_STATIONARY
        bool "SoC audio support for ICX Stationary audio"
        depends on SND_SOC_ICX_BOARD
        select SND_SOC_CXD3776ER
#       select SND_SOC_IISDUM
        select SND_SOC_DIGIAMP
#       select SND_SOC_CANARY
#       select SND_SOC_CXD90020
        help
          Say Y if you want to add support for SoC audio on ICX Stationary Audio.

config SND_SOC_ICX_AUDIO_MOBILE
        bool "SoC audio support (cxd3774gf) for ICX Mobile audio"
        depends on SND_SOC_ICX_BOARD
        select SND_SOC_CXD3774GF
#       select SND_SOC_IISDUM
        select SND_SOC_DIGIAMP
#       select SND_SOC_CANARY
        select SND_SOC_CXD90020
        help
          Say Y if you want to add support for SoC audio (cxd3774gf) on ICX Mobile Audio.

config SND_SOC_ICX_AUDIO_MOBILE_NEXT
        bool "SoC audio support (cxd3778gf) for ICX Mobile audio"
        depends on SND_SOC_ICX_BOARD
        select SND_SOC_CXD3778GF
        help
          Say Y if you want to add support for SoC audio (cxd3778gf) on ICX Mobile Audio.

config SND_SOC_PERIODS_MINIMUM_MEMIF
        int "Minimum periods for memif hardware"
        range 2 4
        default 4
        help
          Minimum periods for memif hardware.
          If unsure, say 4.

config MTK_CM4_WAIT_SPM_FEATURE
	bool "added CM4 wait SPM feature support code."
        default n
	help
          Say Y if you want the wait SPM feature support code.
```
