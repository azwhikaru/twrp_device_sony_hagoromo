## kernel_source/backports-3.17.1-1/Kconfig.kernel
```kconfig
config ARM
    bool
    default y

config ARM_HAS_SG_CHAIN
    bool
    default y

config SYS_SUPPORTS_APM_EMULATION
    bool
    default y

config HAVE_PROC_CPU
    bool
    default y

config STACKTRACE_SUPPORT
    bool
    default y

config LOCKDEP_SUPPORT
    bool
    default y

config TRACE_IRQFLAGS_SUPPORT
    bool
    default y

config RWSEM_GENERIC_SPINLOCK
    bool
    default y

config ARCH_HAS_CPUFREQ
    bool
    default y

config GENERIC_HWEIGHT
    bool
    default y

config GENERIC_CALIBRATE_DELAY
    bool
    default y

config NEED_DMA_MAP_STATE
    bool
    default y

config FIQ
    bool
    default y

config NEED_MACH_MEMORY_H
    bool
    default y

config GENERIC_BUG
    bool
    default y

config IRQ_WORK
    bool
    default y

config BUILDTIME_EXTABLE_SORT
    bool
    default y

config HAVE_KERNEL_GZIP
    bool
    default y

config HAVE_KERNEL_LZMA
    bool
    default y

config HAVE_KERNEL_XZ
    bool
    default y

config HAVE_KERNEL_LZO
    bool
    default y

config KERNEL_XZ
    bool
    default y

config SWAP
    bool
    default y

config SYSVIPC
    bool
    default y

config SYSVIPC_SYSCTL
    bool
    default y

config AUDIT
    bool
    default y

config AUDITSYSCALL
    bool
    default y

config AUDIT_WATCH
    bool
    default y

config AUDIT_TREE
    bool
    default y

config HAVE_GENERIC_HARDIRQS
    bool
    default y

config GENERIC_HARDIRQS
    bool
    default y

config GENERIC_IRQ_PROBE
    bool
    default y

config GENERIC_IRQ_SHOW
    bool
    default y

config HARDIRQS_SW_RESEND
    bool
    default y

config KTIME_SCALAR
    bool
    default y

config GENERIC_CLOCKEVENTS
    bool
    default y

config GENERIC_CLOCKEVENTS_BUILD
    bool
    default y

config ARCH_HAS_TICK_BROADCAST
    bool
    default y

config GENERIC_CLOCKEVENTS_BROADCAST
    bool
    default y

config TICK_ONESHOT
    bool
    default y

config NO_HZ_COMMON
    bool
    default y

config NO_HZ_IDLE
    bool
    default y

config NO_HZ
    bool
    default y

config HIGH_RES_TIMERS
    bool
    default y

config TICK_CPU_ACCOUNTING
    bool
    default y

config TREE_PREEMPT_RCU
    bool
    default y

config PREEMPT_RCU
    bool
    default y

config RCU_STALL_COMMON
    bool
    default y

config IKCONFIG
    bool
    default y

config IKCONFIG_PROC
    bool
    default y

config CGROUPS
    bool
    default y

config CGROUP_CPUACCT
    bool
    default y

config RESOURCE_COUNTERS
    bool
    default y

config CGROUP_SCHED
    bool
    default y

config FAIR_GROUP_SCHED
    bool
    default y

config RT_GROUP_SCHED
    bool
    default y

config UIDGID_CONVERTED
    bool
    default y

config BLK_DEV_INITRD
    bool
    default y

config RD_GZIP
    bool
    default y

config SYSCTL
    bool
    default y

config ANON_INODES
    bool
    default y

config HAVE_UID16
    bool
    default y

config HOTPLUG
    bool
    default y

config UID16
    bool
    default y

config KALLSYMS
    bool
    default y

config KALLSYMS_ALL
    bool
    default y

config PRINTK
    bool
    default y

config BUG
    bool
    default y

config ELF_CORE
    bool
    default y

config BASE_FULL
    bool
    default y

config FUTEX
    bool
    default y

config EPOLL
    bool
    default y

config SIGNALFD
    bool
    default y

config TIMERFD
    bool
    default y

config EVENTFD
    bool
    default y

config SHMEM
    bool
    default y

config AIO
    bool
    default y

config EMBEDDED
    bool
    default y

config HAVE_PERF_EVENTS
    bool
    default y

config PERF_USE_VMALLOC
    bool
    default y

config PERF_EVENTS
    bool
    default y

config VM_EVENT_COUNTERS
    bool
    default y

config SLUB_DEBUG
    bool
    default y

config COMPAT_BRK
    bool
    default y

config SLUB
    bool
    default y

config PROFILING
    bool
    default y

config TRACEPOINTS
    bool
    default y

config OPROFILE
    bool
    default y

config HAVE_OPROFILE
    bool
    default y

config KPROBES
    bool
    default y

config KRETPROBES
    bool
    default y

config HAVE_KPROBES
    bool
    default y

config HAVE_KRETPROBES
    bool
    default y

config HAVE_ARCH_TRACEHOOK
    bool
    default y

config HAVE_DMA_ATTRS
    bool
    default y

config HAVE_DMA_CONTIGUOUS
    bool
    default y

config USE_GENERIC_SMP_HELPERS
    bool
    default y

config GENERIC_SMP_IDLE_THREAD
    bool
    default y

config GENERIC_IDLE_POLL_SETUP
    bool
    default y

config HAVE_REGS_AND_STACK_ACCESS_API
    bool
    default y

config HAVE_DMA_API_DEBUG
    bool
    default y

config HAVE_HW_BREAKPOINT
    bool
    default y

config HAVE_ARCH_JUMP_LABEL
    bool
    default y

config ARCH_WANT_IPC_PARSE_VERSION
    bool
    default y

config HAVE_ARCH_SECCOMP_FILTER
    bool
    default y

config HAVE_CONTEXT_TRACKING
    bool
    default y

config HAVE_IRQ_TIME_ACCOUNTING
    bool
    default y

config MODULES_USE_ELF_REL
    bool
    default y

config CLONE_BACKWARDS
    bool
    default y

config OLD_SIGSUSPEND3
    bool
    default y

config OLD_SIGACTION
    bool
    default y

config HAVE_GENERIC_DMA_COHERENT
    bool
    default y

config SLABINFO
    bool
    default y

config RT_MUTEXES
    bool
    default y

config MODULES
    bool
    default y

config MODULE_UNLOAD
    bool
    default y

config STOP_MACHINE
    bool
    default y

config BLOCK
    bool
    default y

config LBDAF
    bool
    default y

config MSDOS_PARTITION
    bool
    default y

config EFI_PARTITION
    bool
    default y

config IOSCHED_NOOP
    bool
    default y

config IOSCHED_DEADLINE
    bool
    default y

config IOSCHED_CFQ
    bool
    default y

config DEFAULT_CFQ
    bool
    default y

config UNINLINE_SPIN_UNLOCK
    bool
    default y

config FREEZER
    bool
    default y

config MMU
    bool
    default y

config ARCH_MT8590
    bool
    default y

config MT8590_EVB_BOARD
    bool
    default y

config CPU_V7
    bool
    default y

config CPU_32v6K
    bool
    default y

config CPU_32v7
    bool
    default y

config CPU_ABRT_EV7
    bool
    default y

config CPU_PABRT_V7
    bool
    default y

config CPU_CACHE_V7
    bool
    default y

config CPU_CACHE_VIPT
    bool
    default y

config CPU_COPY_V6
    bool
    default y

config CPU_TLB_V7
    bool
    default y

config CPU_HAS_ASID
    bool
    default y

config CPU_CP15
    bool
    default y

config CPU_CP15_MMU
    bool
    default y

config ARCH_HIBERNATION_POSSIBLE
    bool
    default y

config ARM_THUMB
    bool
    default y

config ARM_THUMBEE
    bool
    default y

config ARM_VIRT_EXT
    bool
    default y

config SWP_EMULATE
    bool
    default y

config KUSER_HELPERS
    bool
    default y

config ARM_L1_CACHE_SHIFT_6
    bool
    default y

config ARM_DMA_MEM_BUFFERABLE
    bool
    default y

config FIQ_GLUE
    bool
    default y

config FIQ_DEBUGGER
    bool
    default y

config FIQ_DEBUGGER_CONSOLE
    bool
    default y

config FIQ_DEBUGGER_CONSOLE_DEFAULT_ENABLE
    bool
    default y

config ARM_AMBA
    bool
    default y

config HAVE_SMP
    bool
    default y

config SMP
    bool
    default y

config SMP_ON_UP
    bool
    default y

config ARM_CPU_TOPOLOGY
    bool
    default y

config VMSPLIT_3G
    bool
    default y

config HOTPLUG_CPU
    bool
    default y

config LOCAL_TIMERS
    bool
    default y

config PREEMPT
    bool
    default y

config PREEMPT_COUNT
    bool
    default y

config SCHED_HRTICK
    bool
    default y

config AEABI
    bool
    default y

config HAVE_ARCH_PFN_VALID
    bool
    default y

config HIGHMEM
    bool
    default y

config HW_PERF_EVENTS
    bool
    default y

config FLATMEM
    bool
    default y

config FLAT_NODE_MEM_MAP
    bool
    default y

config HAVE_MEMBLOCK
    bool
    default y

config PAGEFLAGS_EXTENDED
    bool
    default y

config COMPACTION
    bool
    default y

config MIGRATION
    bool
    default y

config BOUNCE
    bool
    default y

config CROSS_MEMORY_ATTACH
    bool
    default y

config ALIGNMENT_TRAP
    bool
    default y

config CC_STACKPROTECTOR
    bool
    default y

config ATAGS
    bool
    default y

config CMDLINE_FROM_BOOTLOADER
    bool
    default y

config RESTART_DISABLE_CACHE
    bool
    default y

config CPU_FREQ
    bool
    default y

config CPU_FREQ_TABLE
    bool
    default y

config CPU_FREQ_GOV_COMMON
    bool
    default y

config CPU_FREQ_STAT
    bool
    default y

config CPU_FREQ_STAT_DETAILS
    bool
    default y

config CPU_FREQ_DEFAULT_GOV_HOTPLUG
    bool
    default y

config CPU_FREQ_GOV_PERFORMANCE
    bool
    default y

config CPU_FREQ_GOV_POWERSAVE
    bool
    default y

config CPU_FREQ_GOV_USERSPACE
    bool
    default y

config CPU_FREQ_GOV_HOTPLUG
    bool
    default y

config VFP
    bool
    default y

config VFPv3
    bool
    default y

config NEON
    bool
    default y

config BINFMT_ELF
    bool
    default y

config ARCH_BINFMT_ELF_RANDOMIZE_PIE
    bool
    default y

config BINFMT_SCRIPT
    bool
    default y

config HAVE_AOUT
    bool
    default y

config COREDUMP
    bool
    default y

config SUSPEND
    bool
    default y

config SUSPEND_FREEZER
    bool
    default y

config HAS_WAKELOCK
    bool
    default y

config HAS_EARLYSUSPEND
    bool
    default y

config WAKELOCK
    bool
    default y

config EARLYSUSPEND
    bool
    default y

config FB_EARLYSUSPEND
    bool
    default y

config HIBERNATE_CALLBACKS
    bool
    default y

config HIBERNATION
    bool
    default y

config TOI_CORE
    bool
    default y

config TOI_FILE
    bool
    default y

config TOI_SWAP
    bool
    default y

config TOI_CRYPTO
    bool
    default y

config TOI_REPLACE_SWSUSP
    bool
    default y

config TOI
    bool
    default y

config TOI_ZRAM_SUPPORT
    bool
    default y

config PM_SLEEP
    bool
    default y

config PM_SLEEP_SMP
    bool
    default y

config PM_AUTOSLEEP
    bool
    default y

config PM_WAKELOCKS
    bool
    default y

config PM_WAKELOCKS_GC
    bool
    default y

config PM
    bool
    default y

config PM_DEBUG
    bool
    default y

config PM_ADVANCED_DEBUG
    bool
    default y

config PM_TEST_SUSPEND
    bool
    default y

config PM_SLEEP_DEBUG
    bool
    default y

config CPU_PM
    bool
    default y

config ARCH_SUSPEND_POSSIBLE
    bool
    default y

config ARM_CPU_SUSPEND
    bool
    default y

config NET
    bool
    default y

config PACKET
    bool
    default y

config UNIX
    bool
    default y

config XFRM
    bool
    default y

config XFRM_ALGO
    bool
    default y

config XFRM_MIGRATE
    bool
    default y

config XFRM_IPCOMP
    bool
    default y

config NET_KEY
    bool
    default y

config INET
    bool
    default y

config IP_MULTICAST
    bool
    default y

config IP_ADVANCED_ROUTER
    bool
    default y

config IP_MULTIPLE_TABLES
    bool
    default y

config IP_ROUTE_CLASSID
    bool
    default y

config IP_PNP
    bool
    default y

config IP_PNP_DHCP
    bool
    default y

config IP_PNP_BOOTP
    bool
    default y

config NET_IPIP
    bool
    default y

config NET_IP_TUNNEL
    bool
    default y

config IP_MROUTE
    bool
    default y

config IP_MROUTE_MULTIPLE_TABLES
    bool
    default y

config IP_PIMSM_V1
    bool
    default y

config IP_PIMSM_V2
    bool
    default y

config ARPD
    bool
    default y

config SYN_COOKIES
    bool
    default y

config INET_AH
    bool
    default y

config INET_ESP
    bool
    default y

config INET_IPCOMP
    bool
    default y

config INET_XFRM_TUNNEL
    bool
    default y

config INET_TUNNEL
    bool
    default y

config INET_XFRM_MODE_TRANSPORT
    bool
    default y

config INET_XFRM_MODE_TUNNEL
    bool
    default y

config INET_XFRM_MODE_BEET
    bool
    default y

config INET_DIAG
    bool
    default y

config INET_TCP_DIAG
    bool
    default y

config TCP_CONG_CUBIC
    bool
    default y

config IPV6
    bool
    default y

config IPV6_PRIVACY
    bool
    default y

config IPV6_ROUTER_PREF
    bool
    default y

config IPV6_ROUTE_INFO
    bool
    default y

config IPV6_OPTIMISTIC_DAD
    bool
    default y

config INET6_AH
    bool
    default y

config INET6_ESP
    bool
    default y

config INET6_IPCOMP
    bool
    default y

config IPV6_MIP6
    bool
    default y

config INET6_XFRM_TUNNEL
    bool
    default y

config INET6_TUNNEL
    bool
    default y

config INET6_XFRM_MODE_TRANSPORT
    bool
    default y

config INET6_XFRM_MODE_TUNNEL
    bool
    default y

config INET6_XFRM_MODE_BEET
    bool
    default y

config INET6_XFRM_MODE_ROUTEOPTIMIZATION
    bool
    default y

config IPV6_SIT
    bool
    default y

config IPV6_SIT_6RD
    bool
    default y

config IPV6_NDISC_NODETYPE
    bool
    default y

config IPV6_TUNNEL
    bool
    default y

config IPV6_MULTIPLE_TABLES
    bool
    default y

config IPV6_SUBTREES
    bool
    default y

config IPV6_MROUTE
    bool
    default y

config IPV6_PIMSM_V2
    bool
    default y

config ANDROID_PARANOID_NETWORK
    bool
    default y

config NET_ACTIVITY_STATS
    bool
    default y

config NETWORK_SECMARK
    bool
    default y

config NETFILTER
    bool
    default y

config NETFILTER_ADVANCED
    bool
    default y

config BRIDGE_NETFILTER
    bool
    default y

config NETFILTER_NETLINK
    bool
    default y

config NETFILTER_NETLINK_QUEUE
    bool
    default y

config NETFILTER_NETLINK_LOG
    bool
    default y

config NF_CONNTRACK
    bool
    default y

config NF_CONNTRACK_MARK
    bool
    default y

config NF_CONNTRACK_PROCFS
    bool
    default y

config NF_CONNTRACK_EVENTS
    bool
    default y

config NF_CT_PROTO_GRE
    bool
    default y

config NF_CT_PROTO_UDPLITE
    bool
    default y

config NF_CONNTRACK_FTP
    bool
    default y

config NF_CONNTRACK_PPTP
    bool
    default y

config NF_CONNTRACK_SIP
    bool
    default y

config NF_CONNTRACK_TFTP
    bool
    default y

config NF_CT_NETLINK
    bool
    default y

config NF_NAT
    bool
    default y

config NF_NAT_NEEDED
    bool
    default y

config NF_NAT_PROTO_UDPLITE
    bool
    default y

config NF_NAT_FTP
    bool
    default y

config NF_NAT_SIP
    bool
    default y

config NF_NAT_TFTP
    bool
    default y

config NETFILTER_TPROXY
    bool
    default y

config NETFILTER_XTABLES
    bool
    default y

config NETFILTER_XT_MARK
    bool
    default y

config NETFILTER_XT_CONNMARK
    bool
    default y

config NETFILTER_XT_TARGET_CLASSIFY
    bool
    default y

config NETFILTER_XT_TARGET_HL
    bool
    default y

config NETFILTER_XT_TARGET_IDLETIMER
    bool
    default y

config NETFILTER_XT_TARGET_MARK
    bool
    default y

config NETFILTER_XT_TARGET_NETMAP
    bool
    default y

config NETFILTER_XT_TARGET_NFLOG
    bool
    default y

config NETFILTER_XT_TARGET_NFQUEUE
    bool
    default y

config NETFILTER_XT_TARGET_REDIRECT
    bool
    default y

config NETFILTER_XT_MATCH_CONNBYTES
    bool
    default y

config NETFILTER_XT_MATCH_IPRANGE
    bool
    default y

config NETFILTER_XT_MATCH_LENGTH
    bool
    default y

config NETFILTER_XT_MATCH_LIMIT
    bool
    default y

config NETFILTER_XT_MATCH_MAC
    bool
    default y

config NETFILTER_XT_MATCH_MARK
    bool
    default y

config NETFILTER_XT_MATCH_MULTIPORT
    bool
    default y

config NETFILTER_XT_MATCH_POLICY
    bool
    default y

config NETFILTER_XT_MATCH_PHYSDEV
    bool
    default y

config NETFILTER_XT_MATCH_QTAGUID
    bool
    default y

config NETFILTER_XT_MATCH_QUOTA
    bool
    default y

config NETFILTER_XT_MATCH_QUOTA2
    bool
    default y

config NETFILTER_XT_MATCH_QUOTA2_LOG
    bool
    default y

config NETFILTER_XT_MATCH_REALM
    bool
    default y

config NETFILTER_XT_MATCH_RECENT
    bool
    default y

config NETFILTER_XT_MATCH_SOCKET
    bool
    default y

config NETFILTER_XT_MATCH_STATE
    bool
    default y

config NETFILTER_XT_MATCH_STATISTIC
    bool
    default y

config NETFILTER_XT_MATCH_STRING
    bool
    default y

config NETFILTER_XT_MATCH_TIME
    bool
    default y

config NETFILTER_XT_MATCH_U32
    bool
    default y

config NF_DEFRAG_IPV4
    bool
    default y

config NF_CONNTRACK_IPV4
    bool
    default y

config NF_CONNTRACK_PROC_COMPAT
    bool
    default y

config IP_NF_IPTABLES
    bool
    default y

config IP_NF_FILTER
    bool
    default y

config IP_NF_TARGET_REJECT
    bool
    default y

config NF_NAT_IPV4
    bool
    default y

config IP_NF_TARGET_MASQUERADE
    bool
    default y

config IP_NF_TARGET_NETMAP
    bool
    default y

config IP_NF_TARGET_REDIRECT
    bool
    default y

config NF_NAT_PROTO_GRE
    bool
    default y

config NF_NAT_PPTP
    bool
    default y

config IP_NF_MANGLE
    bool
    default y

config IP_NF_RAW
    bool
    default y

config IP_NF_ARPTABLES
    bool
    default y

config NF_DEFRAG_IPV6
    bool
    default y

config NF_CONNTRACK_IPV6
    bool
    default y

config IP6_NF_IPTABLES
    bool
    default y

config IP6_NF_MATCH_FRAG
    bool
    default y

config IP6_NF_MATCH_IPV6HEADER
    bool
    default y

config IP6_NF_TARGET_HL
    bool
    default y

config IP6_NF_FILTER
    bool
    default y

config IP6_NF_TARGET_REJECT
    bool
    default y

config IP6_NF_TARGET_REJECT_SKERR
    bool
    default y

config IP6_NF_MANGLE
    bool
    default y

config IP6_NF_RAW
    bool
    default y

config STP
    bool
    default y

config BRIDGE
    bool
    default y

config BRIDGE_IGMP_SNOOPING
    bool
    default y

config HAVE_NET_DSA
    bool
    default y

config VLAN_8021Q
    bool
    default y

config LLC
    bool
    default y

config NET_SCHED
    bool
    default y

config NET_SCH_HTB
    bool
    default y

config NET_SCH_INGRESS
    bool
    default y

config NET_CLS
    bool
    default y

config NET_CLS_FW
    bool
    default y

config NET_CLS_U32
    bool
    default y

config CLS_U32_PERF
    bool
    default y

config CLS_U32_MARK
    bool
    default y

config NET_CLS_FLOW
    bool
    default y

config NET_CLS_ACT
    bool
    default y

config NET_ACT_POLICE
    bool
    default y

config NET_ACT_MIRRED
    bool
    default y

config NET_ACT_IPT
    bool
    default y

config NET_CLS_IND
    bool
    default y

config NET_SCH_FIFO
    bool
    default y

config RPS
    bool
    default y

config RFS_ACCEL
    bool
    default y

config XPS
    bool
    default y

config BQL
    bool
    default y

config FIB_RULES
    bool
    default y

config WIRELESS_EXT
    bool
    default y

config WEXT_CORE
    bool
    default y

config WEXT_PROC
    bool
    default y

config WEXT_PRIV
    bool
    default y

config HAVE_BPF_JIT
    bool
    default y

config STANDALONE
    bool
    default y

config PREVENT_FIRMWARE_BUILD
    bool
    default y

config FW_LOADER
    bool
    default y

config FIRMWARE_IN_KERNEL
    bool
    default y

config FW_LOADER_USER_HELPER
    bool
    default y

config REGMAP
    bool
    default y

config REGMAP_I2C
    bool
    default y

config REGMAP_SPI
    bool
    default y

config DMA_SHARED_BUFFER
    bool
    default y

config MTD
    bool
    default y

config MTD_BLKDEVS
    bool
    default y

config MTD_BLOCK
    bool
    default y

config MTD_MAP_BANK_WIDTH_1
    bool
    default y

config MTD_MAP_BANK_WIDTH_2
    bool
    default y

config MTD_MAP_BANK_WIDTH_4
    bool
    default y

config MTD_CFI_I1
    bool
    default y

config MTD_CFI_I2
    bool
    default y

config MTD_NAND_IDS
    bool
    default y

config MTD_NAND_ECC
    bool
    default y

config MTD_NAND
    bool
    default y

config MTD_NAND_PLATFORM
    bool
    default y

config BLK_DEV
    bool
    default y

config BLK_DEV_LOOP
    bool
    default y

config ANDROID_PMEM
    bool
    default y

config UID_STAT
    bool
    default y

config SCSI_MOD
    bool
    default y

config SCSI
    bool
    default y

config SCSI_DMA
    bool
    default y

config SCSI_TGT
    bool
    default y

config SCSI_PROC_FS
    bool
    default y

config BLK_DEV_SD
    bool
    default y

config SCSI_MULTI_LUN
    bool
    default y

config SCSI_SCAN_ASYNC
    bool
    default y

config MD
    bool
    default y

config BLK_DEV_DM
    bool
    default y

config DM_DEBUG
    bool
    default y

config DM_CRYPT
    bool
    default y

config DM_UEVENT
    bool
    default y

config NETDEVICES
    bool
    default y

config IFB
    bool
    default y

config TUN
    bool
    default y

config PPP
    bool
    default y

config PPP_BSDCOMP
    bool
    default y

config PPP_DEFLATE
    bool
    default y

config PPP_FILTER
    bool
    default y

config PPP_MPPE
    bool
    default y

config PPP_MULTILINK
    bool
    default y

config PPPOE
    bool
    default y

config PPPOLAC
    bool
    default y

config PPPOPNS
    bool
    default y

config PPP_ASYNC
    bool
    default y

config PPP_SYNC_TTY
    bool
    default y

config SLHC
    bool
    default y

config MTK_CONNSYS_WIFI
    tristate
    default m

config MTK_WLAN_SUPPORT
    bool
    default y

config MTK_WAPI_SUPPORT
    bool
    default y

config INPUT
    bool
    default y

config INPUT_MOUSEDEV
    bool
    default y

config INPUT_MOUSEDEV_PSAUX
    bool
    default y

config INPUT_EVDEV
    bool
    default y

config INPUT_KEYBOARD
    bool
    default y

config MTK_KEYPAD
    bool
    default y

config INPUT_MOUSE
    bool
    default y

config INPUT_TOUCHSCREEN
    bool
    default y

config INPUT_MISC
    bool
    default y

config INPUT_UINPUT
    bool
    default y

config TTY
    bool
    default y

config UNIX98_PTYS
    bool
    default y

config LEGACY_PTYS
    bool
    default y

config DEVMEM
    bool
    default y

config DEVKMEM
    bool
    default y

config SERIAL_CORE
    bool
    default y

config SERIAL_CORE_CONSOLE
    bool
    default y

config CONSOLE_POLL
    bool
    default y

config I2C
    bool
    default y

config I2C_BOARDINFO
    bool
    default y

config I2C_COMPAT
    bool
    default y

config I2C_HELPER_AUTO
    bool
    default y

config MTK_I2C
    bool
    default y

config SPI
    bool
    default y

config SPI_MASTER
    bool
    default y

config ARCH_HAVE_CUSTOM_GPIO_H
    bool
    default y

config GPIO_DEVRES
    bool
    default y

config POWER_SUPPLY
    bool
    default y

config THERMAL
    bool
    default y

config THERMAL_DEFAULT_GOV_BACKWARD_COMPATIBLE
    bool
    default y

config BACKWARD_COMPATIBLE
    bool
    default y

config IR_RC5_SZ_DECODER
    bool
    default y

config FB
    bool
    default y

config FB_CFB_FILLRECT
    bool
    default y

config FB_CFB_COPYAREA
    bool
    default y

config FB_CFB_IMAGEBLIT
    bool
    default y

config FB_MODE_HELPERS
    bool
    default y

config FB_TILEBLITTING
    bool
    default y

config FONT_8x16
    bool
    default y

config SOUND
    bool
    default y

config SOUND_OSS_CORE
    bool
    default y

config SOUND_OSS_CORE_PRECLAIM
    bool
    default y

config SND
    bool
    default y

config SND_TIMER
    bool
    default y

config SND_PCM
    bool
    default y

config SND_COMPRESS_OFFLOAD
    bool
    default y

config SND_JACK
    bool
    default y

config SND_OSSEMUL
    bool
    default y

config SND_PCM_OSS
    bool
    default y

config SND_DYNAMIC_MINORS
    bool
    default y

config SND_VERBOSE_PROCFS
    bool
    default y

config SND_DRIVERS
    bool
    default y

config SND_SOC
    bool
    default y

config SND_SOC_MT8590
    bool
    default y

config SND_SOC_I2C_AND_SPI
    bool
    default y

config HID
    bool
    default y

config UHID
    bool
    default y

config KEYBOARD_HID
    bool
    default y

config HID_GENERIC
    bool
    default y

config HID_A4TECH
    bool
    default y

config HID_APPLE
    bool
    default y

config HID_BELKIN
    bool
    default y

config HID_CHERRY
    bool
    default y

config HID_CHICONY
    bool
    default y

config HID_CYPRESS
    bool
    default y

config HID_DRAGONRISE
    bool
    default y

config HID_EZKEY
    bool
    default y

config HID_KYE
    bool
    default y

config HID_GYRATION
    bool
    default y

config HID_TWINHAN
    bool
    default y

config HID_KENSINGTON
    bool
    default y

config HID_LOGITECH
    bool
    default y

config HID_MICROSOFT
    bool
    default y

config HID_MONTEREY
    bool
    default y

config HID_NTRIG
    bool
    default y

config HID_PANTHERLORD
    bool
    default y

config HID_PETALYNX
    bool
    default y

config HID_SAMSUNG
    bool
    default y

config HID_SONY
    bool
    default y

config HID_SUNPLUS
    bool
    default y

config HID_GREENASIA
    bool
    default y

config HID_SMARTJOYPLUS
    bool
    default y

config HID_TOPSEED
    bool
    default y

config HID_THRUSTMASTER
    bool
    default y

config HID_ZEROPLUS
    bool
    default y

config USB_HID
    bool
    default y

config USB_SUPPORT
    bool
    default y

config USB_COMMON
    bool
    default y

config USB_ARCH_HAS_HCD
    bool
    default y

config USB
    bool
    default y

config USB_DEBUG
    bool
    default y

config USB_DEFAULT_PERSIST
    bool
    default y

config USB_STORAGE
    bool
    default y

config USB_STORAGE_DEBUG
    bool
    default y

config USB_STORAGE_DATAFAB
    bool
    default y

config USB_STORAGE_FREECOM
    bool
    default y

config USB_STORAGE_ISD200
    bool
    default y

config USB_STORAGE_USBAT
    bool
    default y

config USB_STORAGE_SDDR09
    bool
    default y

config USB_STORAGE_SDDR55
    bool
    default y

config USB_STORAGE_JUMPSHOT
    bool
    default y

config USB_STORAGE_ALAUDA
    bool
    default y

config USB_STORAGE_ONETOUCH
    bool
    default y

config USB_STORAGE_KARMA
    bool
    default y

config USB_STORAGE_CYPRESS_ATACB
    bool
    default y

config USB_TRANCEVIBRATOR
    bool
    default y

config USB_PHY
    bool
    default y

config NOP_USB_XCEIV
    bool
    default y

config USB_GADGET
    bool
    default y

config USB_LIBCOMPOSITE
    bool
    default y

config USB_F_ACM
    bool
    default y

config USB_U_SERIAL
    bool
    default y

config USB_G_ANDROID
    bool
    default y

config MTK_MULTI_STORAGE_SUPPORT
    bool
    default y

config MMC
    bool
    default y

config MMC_UNSAFE_RESUME
    bool
    default y

config MTK_EMMC_SUPPORT
    bool
    default y

config MMC_BLOCK
    bool
    default y

config MMC_BLOCK_BOUNCE
    bool
    default y

config NEW_LEDS
    bool
    default y

config LEDS_CLASS
    bool
    default y

config LEDS_TRIGGERS
    bool
    default y

config LEDS_TRIGGER_TIMER
    bool
    default y

config SWITCH
    bool
    default y

config RTC_LIB
    bool
    default y

config RTC_CLASS
    bool
    default y

config RTC_HCTOSYS
    bool
    default y

config RTC_SYSTOHC
    bool
    default y

config RTC_INTF_SYSFS
    bool
    default y

config RTC_INTF_PROC
    bool
    default y

config RTC_INTF_DEV
    bool
    default y

config STAGING
    bool
    default y

config ZSMALLOC
    bool
    default y

config ZRAM
    bool
    default y

config ZRAM_DEBUG
    bool
    default y

config ANDROID
    bool
    default y

config ANDROID_BINDER_IPC
    bool
    default y

config ASHMEM
    bool
    default y

config ANDROID_LOGGER
    bool
    default y

config ANDROID_TIMED_OUTPUT
    bool
    default y

config ANDROID_LOW_MEMORY_KILLER
    bool
    default y

config ANDROID_LOW_MEMORY_KILLER_AUTODETECT_OOM_ADJ_VALUES
    bool
    default y

config ANDROID_INTF_ALARM_DEV
    bool
    default y

config AMAZON_METRICS_LOG
    bool
    default y

config SYNC
    bool
    default y

config SW_SYNC
    bool
    default y

config SW_SYNC_USER
    bool
    default y

config ION
    bool
    default y

config DCACHE_WORD_ACCESS
    bool
    default y

config EXT3_FS
    bool
    default y

config EXT3_FS_XATTR
    bool
    default y

config EXT3_FS_POSIX_ACL
    bool
    default y

config EXT4_FS
    bool
    default y

config EXT4_FS_SECURITY
    bool
    default y

config JBD
    bool
    default y

config JBD_DEBUG
    bool
    default y

config JBD2
    bool
    default y

config FS_MBCACHE
    bool
    default y

config FS_POSIX_ACL
    bool
    default y

config FILE_LOCKING
    bool
    default y

config FSNOTIFY
    bool
    default y

config DNOTIFY
    bool
    default y

config INOTIFY_USER
    bool
    default y

config FUSE_FS
    bool
    default y

config GENERIC_ACL
    bool
    default y

config ISO9660_FS
    bool
    default y

config JOLIET
    bool
    default y

config ZISOFS
    bool
    default y

config FAT_FS
    bool
    default y

config MSDOS_FS
    bool
    default y

config VFAT_FS
    bool
    default y

config PROC_FS
    bool
    default y

config PROC_SYSCTL
    bool
    default y

config PROC_PAGE_MONITOR
    bool
    default y

config SYSFS
    bool
    default y

config TMPFS
    bool
    default y

config TMPFS_POSIX_ACL
    bool
    default y

config TMPFS_XATTR
    bool
    default y

config CONFIGFS_FS
    bool
    default y

config MISC_FILESYSTEMS
    bool
    default y

config NETWORK_FILESYSTEMS
    bool
    default y

config NLS
    bool
    default y

config NLS_CODEPAGE_437
    bool
    default y

config NLS_CODEPAGE_950
    bool
    default y

config NLS_ASCII
    bool
    default y

config NLS_ISO8859_1
    bool
    default y

config NLS_UTF8
    bool
    default y

config PRINTK_TIME
    bool
    default y

config ENABLE_WARN_DEPRECATED
    bool
    default y

config ENABLE_MUST_CHECK
    bool
    default y

config MAGIC_SYSRQ
    bool
    default y

config DEBUG_FS
    bool
    default y

config DEBUG_KERNEL
    bool
    default y

config PANIC_ON_OOPS
    bool
    default y

config SCHED_DEBUG
    bool
    default y

config SCHEDSTATS
    bool
    default y

config SLUB_DEBUG_ON
    bool
    default y

config HAVE_DEBUG_KMEMLEAK
    bool
    default y

config DEBUG_PREEMPT
    bool
    default y

config DEBUG_SPINLOCK
    bool
    default y

config DEBUG_MUTEXES
    bool
    default y

config DEBUG_LOCK_ALLOC
    bool
    default y

config PROVE_LOCKING
    bool
    default y

config LOCKDEP
    bool
    default y

config DEBUG_LOCKDEP
    bool
    default y

config TRACE_IRQFLAGS
    bool
    default y

config STACKTRACE
    bool
    default y

config DEBUG_BUGVERBOSE
    bool
    default y

config DEBUG_INFO
    bool
    default y

config FRAME_POINTER
    bool
    default y

config RCU_CPU_STALL_VERBOSE
    bool
    default y

config NOP_TRACER
    bool
    default y

config HAVE_FUNCTION_TRACER
    bool
    default y

config HAVE_FUNCTION_GRAPH_TRACER
    bool
    default y

config HAVE_DYNAMIC_FTRACE
    bool
    default y

config HAVE_FTRACE_MCOUNT_RECORD
    bool
    default y

config HAVE_SYSCALL_TRACEPOINTS
    bool
    default y

config HAVE_C_RECORDMCOUNT
    bool
    default y

config TRACE_CLOCK
    bool
    default y

config RING_BUFFER
    bool
    default y

config EVENT_TRACING
    bool
    default y

config CONTEXT_SWITCH_TRACER
    bool
    default y

config RING_BUFFER_ALLOW_SWAP
    bool
    default y

config TRACING
    bool
    default y

config GENERIC_TRACER
    bool
    default y

config TRACING_SUPPORT
    bool
    default y

config FTRACE
    bool
    default y

config FUNCTION_TRACER
    bool
    default y

config FUNCTION_GRAPH_TRACER
    bool
    default y

config BRANCH_PROFILE_NONE
    bool
    default y

config DYNAMIC_FTRACE
    bool
    default y

config FUNCTION_PROFILER
    bool
    default y

config FTRACE_MCOUNT_RECORD
    bool
    default y

config HAVE_ARCH_KGDB
    bool
    default y

config KGDB
    bool
    default y

config KGDB_SERIAL_CONSOLE
    bool
    default y

config KGDB_KDB
    bool
    default y

config OLD_MCOUNT
    bool
    default y

config DEBUG_RODATA
    bool
    default y

config SECURITY
    bool
    default y

config SECURITY_NETWORK
    bool
    default y

config SECURITY_SELINUX
    bool
    default y

config SECURITY_SELINUX_BOOTPARAM
    bool
    default y

config SECURITY_SELINUX_DEVELOP
    bool
    default y

config SECURITY_SELINUX_AVC_STATS
    bool
    default y

config DEFAULT_SECURITY_SELINUX
    bool
    default y

config CRYPTO
    bool
    default y

config CRYPTO_ALGAPI
    bool
    default y

config CRYPTO_ALGAPI2
    bool
    default y

config CRYPTO_AEAD
    bool
    default y

config CRYPTO_AEAD2
    bool
    default y

config CRYPTO_BLKCIPHER
    bool
    default y

config CRYPTO_BLKCIPHER2
    bool
    default y

config CRYPTO_HASH
    bool
    default y

config CRYPTO_HASH2
    bool
    default y

config CRYPTO_RNG2
    bool
    default y

config CRYPTO_PCOMP2
    bool
    default y

config CRYPTO_MANAGER
    bool
    default y

config CRYPTO_MANAGER2
    bool
    default y

config CRYPTO_MANAGER_DISABLE_TESTS
    bool
    default y

config CRYPTO_WORKQUEUE
    bool
    default y

config CRYPTO_AUTHENC
    bool
    default y

config CRYPTO_CBC
    bool
    default y

config CRYPTO_ECB
    bool
    default y

config CRYPTO_HMAC
    bool
    default y

config CRYPTO_CRC32C
    bool
    default y

config CRYPTO_MD5
    bool
    default y

config CRYPTO_SHA1
    bool
    default y

config CRYPTO_SHA256
    bool
    default y

config CRYPTO_AES
    bool
    default y

config CRYPTO_ARC4
    bool
    default y

config CRYPTO_DES
    bool
    default y

config CRYPTO_TWOFISH
    bool
    default y

config CRYPTO_TWOFISH_COMMON
    bool
    default y

config CRYPTO_DEFLATE
    bool
    default y

config CRYPTO_LZO
    bool
    default y

config BINARY_PRINTF
    bool
    default y

config BITREVERSE
    bool
    default y

config GENERIC_STRNCPY_FROM_USER
    bool
    default y

config GENERIC_STRNLEN_USER
    bool
    default y

config GENERIC_PCI_IOMAP
    bool
    default y

config GENERIC_IO
    bool
    default y

config CRC_CCITT
    bool
    default y

config CRC16
    bool
    default y

config CRC32
    bool
    default y

config CRC32_SLICEBY8
    bool
    default y

config LIBCRC32C
    bool
    default y

config AUDIT_GENERIC
    bool
    default y

config ZLIB_INFLATE
    bool
    default y

config ZLIB_DEFLATE
    bool
    default y

config LZO_COMPRESS
    bool
    default y

config LZO_DECOMPRESS
    bool
    default y

config DECOMPRESS_GZIP
    bool
    default y

config GENERIC_ALLOCATOR
    bool
    default y

config TEXTSEARCH
    bool
    default y

config TEXTSEARCH_KMP
    bool
    default y

config TEXTSEARCH_BM
    bool
    default y

config TEXTSEARCH_FSM
    bool
    default y

config HAS_IOMEM
    bool
    default y

config HAS_IOPORT
    bool
    default y

config HAS_DMA
    bool
    default y

config CPU_RMAP
    bool
    default y

config DQL
    bool
    default y

config NLATTR
    bool
    default y

config ARCH_HAS_ATOMIC64_DEC_IF_POSITIVE
    bool
    default y

config MEDIATEK_SOLUTION
    bool
    default y

config HAVE_XLOG_FEATURE
    bool
    default y

config MTK_NEW_COMBO_EMMC_SUPPORT
    bool
    default y

config MTK_SECURITY_SW_SUPPORT
    bool
    default y

config HAVE_MTK_IN_HOUSE_TEE_SUPPORT
    bool
    default y

config MTK_IN_HOUSE_TEE_SUPPORT
    bool
    default y

config HAVE_TRUSTONIC_TEE_SUPPORT
    bool
    default y

config MTK_OVERLAY_ENGINE_SUPPORT
    bool
    default y

config MTK_MEMCFG
    bool
    default y

config MTK_SENSOR_SUPPORT
    bool
    default y

config CUSTOM_KERNEL_ACCELEROMETER
    bool
    default y

config CUSTOM_KERNEL_GYROSCOPE
    bool
    default y

config CUSTOM_KERNEL_ALSPS
    bool
    default y

config CUSTOM_KERNEL_MAGNETOMETER
    bool
    default y

config MTK_SCHED_TRACERS
    bool
    default y

config FUNCTION_DURATION_TRACER
    bool
    default y

config MT65XX_TRACER
    bool
    default y

config MTK_MET
    bool
    default y

config MTK_MET_PLF
    bool
    default y

config MTK_MUTATION
    bool
    default y

config MTPROF_CPUTIME
    bool
    default y

config MTPROF_IRQ_DURATION
    bool
    default y

config MTK_AEE_FEATURE
    bool
    default y

config MTK_AEE_AED
    bool
    default y

config MTK_AEE_IPANIC
    bool
    default y

config MTK_AEE_MRDUMP
    bool
    default y

config MTK_RAM_CONSOLE
    bool
    default y

config MTK_RAM_CONSOLE_USING_SRAM
    bool
    default y

config PREEMPT_MONITOR
    bool
    default y

config MT_SCHED_MONITOR
    bool
    default y

config MT_CHRDEV_REG
    bool
    default y

config MT_DEBUG_MUTEXES
    bool
    default y

config PRINTK_PROCESS_INFO
    bool
    default y

config MT_ENG_BUILD
    bool
    default y

config EARLY_LINUX_PORTING
    bool
    default y

config MT_SCHED
    bool
    default y

config MTK_CIRQ
    bool
    default y

config MTK_HIBERNATION
    bool
    default y

config MTK_WQ_DEBUG
    bool
    default y

config MTK_STORAGE_PID_LOGGER
    bool
    default y

config MTK_LEGACY_GPIO_DRIVER
    bool
    default y

config MTK_ACCDET
    bool
    default y

config MTK_FB
    bool
    default y

config MTK_FB_SUPPORT_ASSERTION_LAYER
    bool
    default y

config MTK_M4U_SUPPORT
    bool
    default y

config MTK_DITHERING_SUPPORT
    bool
    default y

config HX8392A_DSI_VDO
    bool
    default y

config GPS
    bool
    default y

config MTK_GPS
    bool
    default y

config NFC_MT6605
    bool
    default y

config MTK_BTIF
    bool
    default y

config MTK_NFC_SUPPORT
    bool
    default y

config MTK_COMBO
    bool
    default y

config MTK_COMBO_CHIP_CONSYS_8590
    bool
    default y

config MTK_COMBO_GPS
    bool
    default y

config MTK_GPS_SUPPORT
    bool
    default y

config MTK_FM
    bool
    default y

config MTK_IDLE_TIME_FIX
    bool
    default y

config MTK_G2D
    bool
    default y

config MTK_MPEG4_DEC_DRIVER
    bool
    default y

config MTK_MPEG4_ENC_DRIVER
    bool
    default y

config MTK_H264_DEC_DRIVER
    bool
    default y

config MTK_MFLEXVIDEO_DRIVER
    bool
    default y

config MTK_VIDEOCODEC_DRIVER
    bool
    default y

config MTK_HDMI_SUPPORT
    bool
    default y

config MTK_INTERNAL_HDMI_SUPPORT
    bool
    default y

config MTK_HDMI_HDCP_SUPPORT
    bool
    default y

config MTK_SPI
    bool
    default y

config MTK_JPEG
    bool
    default y

config MTK_LEDS
    bool
    default y

config MTK_MMC
    bool
    default y

config MTK_SMART_BATTERY
    bool
    default y

config MTK_PMIC
    bool
    default y

config MTK_PMIC_WRAP
    bool
    default y

config POWER_EXT
    bool
    default y

config MTK_DISABLE_POWER_ON_OFF_VOLTAGE_LIMITATION
    bool
    default y

config MTK_RTC
    bool
    default y

config MTK_SERIAL
    bool
    default y

config MTK_SERIAL_CONSOLE
    bool
    default y

config MTK_SIM2
    bool
    default y

config MTK_TOUCHPANEL
    bool
    default y

config MTK_USB_GADGET
    bool
    default y

config MTK_VIBRATOR
    bool
    default y

config USB_MTK_ACM_TEMP
    bool
    default y

config USB_MTK_HDRC
    bool
    default y

config USB_MTK_HDRC_GADGET
    bool
    default y

config USB_MTK_OTG
    bool
    default y

config USB_MTK_DEBUG_FS
    bool
    default y

config USB_MTK_DEBUG
    bool
    default y

config USB_MTK_HDRC_HCD
    bool
    default y

config MTK_USBFSH
    bool
    default y

config ION_MTK
    bool
    default y

config MMPROFILE
    bool
    default y

config MTK_STAGING
    bool
    default y

config MTK_IRRX_SUPPORT
    bool
    default y

config MTK_AAL_SUPPORT
    bool
    default y

config MTK_FLASHLIGHT_DUMMYFLASHLIGHT_SUPPORT
    bool
    default y

config MTK_V4L2_VIDEO_SUPPORT
    bool
    default y

config MTK_COMBO_WIFI
    bool
    default y

config MTK_C4A_SUPPORT
    bool
    default y
```
