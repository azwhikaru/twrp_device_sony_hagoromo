## kernel_source/arch/arm/mach-mt8590/Kconfig
```kconfig
if ARCH_MT8590

menu "MT8590 Board Support Package"

choice
	bool "Board"

config MT8590_FPGA
	bool "MT8590 FPGA"
	select ARM_L1_CACHE_SHIFT_6
	help
	  Select if you are using the FPGA board.

config MT8590_EVB_BOARD
	bool "MT8590 EVB BOARD"
	select ARM_L1_CACHE_SHIFT_6
	help
	 Select if you are using an EVB board.

endchoice

config MT8590_FPGA_CA7
	tristate "MT8590 FPGA CA7" 
	depends on MT8590_FPGA
	default n
	help
	    Select if you are using the CA7 FPGA board.

config MAX_DRAM_SIZE_SUPPORT
	hex "The maximum size of the DRAM can be supported in the kernel"
	default 0x40000000
	depends on ARCH_MT8590
	help
		Define the maximum size of the kernel can be supported.
	        If will modify the memory size if it size is smaller than 
                the memory size passed by the boot loader to the MAX_DRAM_SIZE_SUPPORT.
   		Notice that the maximum DRAM size is including the memory size
	        reserved for the modem and the PMEM.

config REGMON_DEBUG
        bool "regmon debug"
        depends on PROC_FS
        help
          enable regmon debug

config ICX_DEBUG
		bool "Enable Debug Module"
		depends on ARCH_MT8590_ICX
		default n
		help
		  enable ICX debug module

config KEEP_VMC_ON_AT_WARM_SLEEP
	bool "keep VMC on at warm sleep"
	default n
	help
	  Select if you want to keep VMC power on at the warm sleep.

endmenu

menu "Tuner devices"

config RICHO_RICOH5B
	tristate "Use RICHO5B tuner device"
	default n
	help
	  This driver provides support for RICHO RICHO5B tuner devices.

	  Say Y here to compile support for RICHO5B devices into the
	  kernel or say M to compile it as module (RICHO5B).

endmenu

endif
```
